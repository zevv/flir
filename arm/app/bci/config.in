## arm/app/bci/config.in
```kconfig
config APP_BCI
	bool "BCI battery control interface"
	select DRV_LED 
	select DRV_ADC 
	select DRV_UART 
	select DRV_BUTTON 
	select DRV_RELAY 
	select LIB_CANOPEN
	select LIB_CANOPEN_MASTER

source app/bci/modules/config.in
```

## arm/app/bci/modules/config.in
```kconfig
config APP_BCI_MOD_NMEA2000
	bool "NMEA-2000 protocol module"
	default y
	depends on APP_BCI

config APP_BCI_MOD_SMA
	bool "SMA protocol module"
	default y
	depends on APP_BCI

config APP_BCI_MOD_PHILIPPI
	bool "Philippi protocol module"
	default y
	depends on APP_BCI
```

## arm/app/config.in
```kconfig
menu "Applications"

config APP_BLINK
	bool "Blink test app"
	select DRV_LED 
	select DRV_UART 

source "app/bci/config.in"

config APP_BMS
	bool "BMS battery management system"
	select DRV_UART 
	select DRV_LED 
	select LIB_CANOPEN

endmenu
```

## arm/bios/config.in
```kconfig
menu "BIOS settings"

config BIOS_LOG_RB_SIZE
	int "Log history ringbuffer size"
	default 1024

endmenu
```

## arm/config.in
```kconfig
config HAVE_DOT_CONFIG
	bool
	default y
	select DRV_UART

config ARCH_STM32
	bool

config ARCH_LINUX
	bool

config ARCH_LPC
	bool

config ARCH_AVR
	bool

config ARCH_WIN32
	bool

########################################################################

config NAME
	string "Product name"
	default "app"

source "plat/config.in"
source "bios/config.in"
source "app/config.in"
source "lib/config.in"
source "drv/config.in"
source "lint/config.in"


menu "Build options"

config BUILD_VERBOSE
	bool "Build verbose"

config BUILD_OPTIMIZATION
	string "Optimization level"
	default "-Os"

config BUILD_CCACHE
	bool "Use ccache to speed up compilation"
	default y

config BUILD_SANITIZE
	bool "Enable gcc address sanitizer"

config BUILD_COVERAGE
	bool "Enable gcov/lcov coverage testing"

config BUILD_FLTO
	bool "Compile and link with link time optimalization (-flto)"

config BUILD_GC_SECTIONS
	bool "Build using gc-sections"


endmenu

config ENABLE_TESTS
	bool "Enable test code"

########################################################################
```

## arm/drv/adc/config.in
```kconfig
menuconfig DRV_ADC
	bool "ADC drivers"

if DRV_ADC

config DRV_ADC_STM32
	bool "STM32 ADC driver"
	default y
	depends on DRV_ADC && ARCH_STM32

config DRV_ADC_DUMMY
	bool "Dummy ADC driver"
	default y
	depends on DRV_ADC

config DRV_ADC_AVR
	bool "Atmel AVR ADC driver"
	default y
	depends on DRV_ADC && ARCH_AVR

endif
```

## arm/drv/button/config.in
```kconfig
menuconfig DRV_BUTTON
	bool "button drivers"

if DRV_BUTTON

config DRV_BUTTON_LINUX
	bool "Linux button driver"
	default y
	depends on DRV_BUTTON && ARCH_LINUX

config DRV_BUTTON_GPIO
	bool "GPIO button driver"
	default y
	depends on DRV_BUTTON


endif
```

## arm/drv/can/config.in
```kconfig
menuconfig DRV_CAN
	bool "CAN drivers"

if DRV_CAN

config DRV_CAN_STM32
	bool "STM32 CAN driver"
	default y
	depends on DRV_CAN && ARCH_STM32

config DRV_CAN_LINUX
	bool "Linux CAN driver"
	default y
	depends on DRV_CAN && ARCH_LINUX

config DRV_CAN_IXXAT
	bool "Ixxat VCI CAN driver"
	default y
	depends on DRV_CAN && ARCH_WIN32

config DRV_CAN_SOCKETCAND
	bool "TCP socketcand interface"
	depends on DRV_CAN && (ARCH_WIN32 || ARCH_LINUX)

config DRV_CAN_DUMMY
	bool "Dummy CAN driver"
	default y
	depends on DRV_CAN && ARCH_WIN32

endif
```

## arm/drv/config.in
```kconfig
menu "Drivers"

source "drv/adc/config.in"
source "drv/button/config.in"
source "drv/can/config.in"
source "drv/eeprom/config.in"
source "drv/fan/config.in"
source "drv/gpio/config.in"
source "drv/led/config.in"
source "drv/relay/config.in"
source "drv/rtc/config.in"
source "drv/spi/config.in"
source "drv/i2c/config.in"
source "drv/uart/config.in"
source "drv/mmc/config.in"

endmenu
```

## arm/drv/eeprom/config.in
```kconfig
menuconfig DRV_EEPROM
	bool "EEPROM drivers"

if DRV_EEPROM

config DRV_EEPROM_AT25
	bool "AT25 SPI EEPROM driver"
	default y
	depends on DRV_EEPROM && ARCH_STM32 && DRV_SPI

config DRV_EEPROM_STDIO
	bool "STDIO EEPROM driver"
	default n
	depends on DRV_EEPROM && (ARCH_LINUX || ARCH_WIN32)

endif
```

## arm/drv/fan/config.in
```kconfig
menuconfig DRV_FAN
	bool "Fan drivers"

if DRV_FAN

config DRV_FAN_STM32
	bool "STM32 fan driver"
	default y
	depends on DRV_FAN && ARCH_STM32

config DRV_FAN_LINUX
	bool "Linux fan driver"
	default y
	depends on DRV_FAN && ARCH_LINUX

endif
```

## arm/drv/gpio/config.in
```kconfig
menuconfig DRV_GPIO
	bool "GPIO drivers"

if DRV_GPIO

config DRV_GPIO_STM32
	bool "STM32 GPIO driver"
	default y
	depends on DRV_GPIO && ARCH_STM32

config DRV_GPIO_LPC
	bool "LPC GPIO driver"
	default y
	depends on DRV_GPIO && ARCH_LPC

config DRV_GPIO_DUMMY
	bool "Dummy GPIO driver"
	default n
	depends on DRV_GPIO

config DRV_GPIO_AVR
	bool "Atmel AVR GPIO driver"
	default y
	depends on DRV_GPIO && ARCH_AVR

config DRV_GPIO_SPI
	bool "SPI connected GPIO driver"
	default n
	depends on DRV_GPIO && DRV_SPI

endif
```

## arm/drv/i2c/config.in
```kconfig
menuconfig DRV_I2C
	bool "I2C drivers"

if DRV_I2C

config DRV_I2C_LPC
	bool "LPC I2C driver"
	default y
	depends on DRV_I2C && ARCH_LPC

endif
```

## arm/drv/led/config.in
```kconfig
menuconfig DRV_LED
	bool "LED drivers"

if DRV_LED

config DRV_LED_GPIO
	bool "GPIO LED driver"
	default y
	depends on DRV_LED && DRV_GPIO

config DRV_LED_LINUX
	bool "Linux LED driver"
	default y
	depends on DRV_LED && ARCH_LINUX

endif
```

## arm/drv/mmc/config.in
```kconfig
menuconfig DRV_MMC
	bool "MMC drivers"

if DRV_MMC

config DRV_MMC_SPI
	bool "SPI MMC driver"
	default y
	depends on DRV_MMC && DRV_SPI

config DRV_MMC_STDIO
	bool "STDIO MMC emulation driver"
	default n
	depends on DRV_MMC && (ARCH_LINUX || ARCH_WIN32)

endif
```

## arm/drv/modbus/config.in
```kconfig
menuconfig DRV_MODBUS
	bool "Modbus drivers"

if DRV_MODBUS

config DRV_MODBUS_TCP
	bool "Modbus TCP driver"
	depends on DRV_MODBUS 


endif
```

## arm/drv/power/config.in
```kconfig
menuconfig DRV_POWER
	bool "Power supply drivers"

if DRV_POWER

config DRV_POWER_EA_9X000
	bool "EA_9X00 power supply / load"
	depends on DRV_POWER && DRV_UART

config DRV_POWER_DUMMY
	bool "Dummy power supply emulation driver"
	default n
	depends on DRV_POWER

endif
```

## arm/drv/relay/config.in
```kconfig
menuconfig DRV_RELAY
	bool "Relay drivers"

if DRV_RELAY

config DRV_RELAY_GPIO
	bool "GPIO relay driver"
	default y
	depends on DRV_RELAY 

endif
```

## arm/drv/rtc/config.in
```kconfig
menuconfig DRV_RTC
	bool "RTC drivers"

if DRV_RTC

config DRV_RTC_LINUX
	bool "Linux RTC driver"
	default y
	depends on DRV_RTC && ARCH_LINUX

endif
```

## arm/drv/spi/config.in
```kconfig
menuconfig DRV_SPI
	bool "SPI drivers"

if DRV_SPI

config DRV_SPI_STM32
	bool "STM32 SPI driver"
	default y
	depends on DRV_SPI && ARCH_STM32

config DRV_SPI_LPC
	bool "LPC SPI driver"
	default y
	depends on DRV_SPI && ARCH_LPC

config DRV_SPI_AVR
	bool "Atmel AVR SPI driver"
	default y
	depends on DRV_SPI && ARCH_AVR

endif
```

## arm/drv/uart/config.in
```kconfig
menuconfig DRV_UART
	bool "UART drivers"

if DRV_UART

config DRV_UART_STM32
	bool "STM32 UART driver"
	default y
	depends on DRV_UART && ARCH_STM32

config DRV_UART_LPC
	bool "LPC UART driver"
	default y
	depends on DRV_UART && ARCH_LPC

config DRV_UART_LINUX
	bool "Linux UART driver"
	default y
	depends on DRV_UART && ARCH_LINUX

config DRV_UART_WIN32
	bool "WIN32 UART driver"
	default y
	depends on DRV_UART && ARCH_WIN32

config DRV_UART_STDIO
	bool "STDIO UART driver"
	default n
	depends on DRV_UART && (ARCH_WIN32 || ARCH_LINUX)

config DRV_UART_AVR
	bool "Atmel AVR UART driver"
	default y
	depends on DRV_UART && ARCH_AVR


endif
```

## arm/lib/canopen/config.in
```kconfig
config LIB_CANOPEN
	bool "CANopen"

config LIB_CANOPEN_MASTER
	bool "CANopen master"
	depends on LIB_CANOPEN

config LIB_CANOPEN_STRERROR
	bool "CANopen verbose error strings"
	depends on LIB_CANOPEN

config LIB_CANOPEN_ANALYZER
	bool "CANopen analyzer"
	depends on LIB_CANOPEN
```

## arm/lib/config.in
```kconfig
menu "Libraries"

config LIB_FATFS
	bool "FATfs"

config LIB_FATFS_WRITE
	bool "FATfs write functionalty"
	depends on LIB_FATFS

config LIB_FATFS_MFKFS
	bool "FATfs mkfs"
	depends on LIB_FATFS_WRITE

source "lib/canopen/config.in"

config LIB_HTTPD
	bool "HTTP server"
	depends on (ARCH_LINUX || ARCH_WIN32)

config LIB_UIP
	bool "uIP IP stack"

config LIB_CONFIG
	bool "Configuration store"
	select DRV_NV

config LIB_BATTDB
	bool "Battery database"

endmenu
```

## arm/lint/config.in
```kconfig
menu "Lint options"

config LINT_LEVEL
	int "Lint warning level"
	default 3

config LINT_MISRA
        bool "Lint with MISRA rules"
	default y

endmenu
```

## arm/plat/bms-avr/config.in
```kconfig
config DRV_UART_BITBANG
	bool "Bitbanging UART driver"
	default y
	depends on DRV_UART && PLAT_BMS_AVR
```
